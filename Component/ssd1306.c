#include "ssd1306.h"
#include <stdio.h>
#include <string.h>
#include "user.h"

OLED_HandleTypeDef oled;

static const uint8_t font5x7_cyrillic[64][5] = {
    {0x7E, 0x11, 0x11, 0x11, 0x7E}, // А
    {0x7F, 0x49, 0x49, 0x49, 0x30}, // Б
    {0x7F, 0x49, 0x49, 0x49, 0x36}, // В
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    {0x48, 0x34, 0x14, 0x14, 0x7C}  // я
};


// Функция отправки команды
void OLED_WriteCommand(OLED_HandleTypeDef *oled, uint8_t command) {
    uint8_t data[2] = {OLED_COMMAND, command};
    HAL_I2C_Master_Transmit(oled->hi2c, OLED_ADDRESS << 1, data, 2, HAL_MAX_DELAY);
}

// Функция отправки данных
void OLED_WriteData(OLED_HandleTypeDef *oled, uint8_t data) {
    uint8_t tx_data[2] = {OLED_DATA, data};
    HAL_I2C_Master_Transmit(oled->hi2c, OLED_ADDRESS << 1, tx_data, 2, HAL_MAX_DELAY);
}


// Инициализация дисплея
void OLED_Init(OLED_HandleTypeDef *oled, I2C_HandleTypeDef *hi2c) {
    oled->hi2c = hi2c;
    oled->currentX = 0;
    oled->currentY = 0;
    oled->mempage = 0;
    HAL_Delay(100);
    
    // Последовательность команд инициализации
    OLED_WriteCommand(oled, 0xAE); // Display OFF
    OLED_WriteCommand(oled, 0x20); // Memory addressing mode
    OLED_WriteCommand(oled, 0x00); // Horizontal addressing mode
    OLED_WriteCommand(oled, 0xB0); // Set page start address
    OLED_WriteCommand(oled, 0xC8); // Set COM output scan direction
    OLED_WriteCommand(oled, 0x00); // Set low column address
    OLED_WriteCommand(oled, 0x10); // Set high column address
    OLED_WriteCommand(oled, 0x40); // Set start line address
    OLED_WriteCommand(oled, 0x81); // Set contrast control
    OLED_WriteCommand(oled, 0x7F); // Contrast value
    OLED_WriteCommand(oled, 0xA1); // Set segment re-map
    OLED_WriteCommand(oled, 0xA6); // Set normal display
    OLED_WriteCommand(oled, 0xA8); // Set multiplex ratio
    OLED_WriteCommand(oled, 0x1F); // 1/32 duty
    OLED_WriteCommand(oled, 0xD3); // Set display offset
    OLED_WriteCommand(oled, 0x00); // No offset
    OLED_WriteCommand(oled, 0xD5); // Set display clock divide ratio
    OLED_WriteCommand(oled, 0xF0); // Set divide ratio
    OLED_WriteCommand(oled, 0xD9); // Set pre-charge period
    OLED_WriteCommand(oled, 0x22); // 
    OLED_WriteCommand(oled, 0xDA); // Set COM pins hardware configuration
    OLED_WriteCommand(oled, 0x02); // 
    OLED_WriteCommand(oled, 0xDB); // Set VCOMH deselect level
    OLED_WriteCommand(oled, 0x20); // 
    OLED_WriteCommand(oled, 0x8D); // Set DC-DC enable
    OLED_WriteCommand(oled, 0x14); // 
    OLED_WriteCommand(oled, 0xAF); // Display ON
    
    // Очистка дисплея
    OLED_Clear(oled);
}

// Очистка дисплея
void OLED_Clear(OLED_HandleTypeDef *oled) {
    memset(oled->buffer, 0, sizeof(oled->buffer));
    OLED_UpdateScreen(oled);
}

// Обновление экрана
int u = 0;
void OLED_UpdateScreen(OLED_HandleTypeDef *oled) {
    for (int i = 0; i < 4; i++) {
        OLED_WriteCommand(oled, 0xB0 + i); // Set page address
        OLED_WriteCommand(oled, 0x00);     // Set lower column address
        OLED_WriteCommand(oled, 0x10);     // Set higher column address
        
        for (int j = 0; j < OLED_WIDTH; j++) {
            if (u == 0)
                {OLED_WriteData(oled, ~oled->buffer[j + ((i + oled->mempage * 4) * OLED_WIDTH)]);}
            else
                {OLED_WriteData(oled,  oled->buffer[j + ((i + oled->mempage * 4) * OLED_WIDTH)]);}

            //DWT_Delay(0.005);
        }
    }

    if( u == 0)
        {u = 1;}
    else
        {u = 1;}
}

// Установка позиции курсора
void OLED_SetCursor(OLED_HandleTypeDef *oled, uint16_t x, uint16_t y) {
    oled->currentX = x;
    oled->currentY = y;
}

// Очистка области под символ
void OLED_ClearCharArea(OLED_HandleTypeDef *oled, uint16_t x, uint16_t y) {
    // Очищаем область 7x8 пикселей (5x7 символ + отступы)
    for (uint8_t i = 0; i < 7; i++) {
        uint32_t col = x + i;
        if (col >= OLED_WIDTH) continue;
        
        for (uint8_t row = 0; row < 8; row++) {
            uint32_t page = (y + row) / 8;
            uint32_t bit_pos = (y + row) % 8;
            uint32_t buffer_index = col + (page * OLED_WIDTH);
            
            if (buffer_index < sizeof(oled->buffer)) {
                oled->buffer[buffer_index] &= ~(1 << bit_pos); // Очищаем бит
            }
        }
    }
}

// Простой вывод символа (базовый шрифт 5x7)
void OLED_WriteChar(OLED_HandleTypeDef *oled, char ch) {
    unsigned char c = (unsigned char)ch;

        // Очищаем область перед выводом нового символа
    OLED_ClearCharArea(oled, oled->currentX, oled->currentY);
    
    const uint8_t *charData = NULL;

    if (c >= 32 && c <= 127) {

    
    // Простой шрифт 5x7 (каждый символ занимает 5 байт)
    static const uint8_t font5x7[] = {
	0x00, 0x00, 0x00, 0x00, 0x00,// (space)
	0x00, 0x00, 0x5F, 0x00, 0x00,// !
	0x00, 0x07, 0x00, 0x07, 0x00,// "
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	0x08, 0x1C, 0x2A, 0x08, 0x08 // <-
    };
    

    uint8_t charIndex = c - 32;
    charData = &font5x7[charIndex * 5];
}
    else if (c >= 0xC0) {
        charData = font5x7_cyrillic[c - 0xC0];
    } else {
        /* Непечатные/неподдерживаемые (0x00–0x1F, 0x80–0xBF) — пропускаем */
        return;
    }

    /* Рисуем символ в буфере (ваша существующая логика) */
    for (uint8_t i = 0; i < 5; i++) {
        uint16_t x = oled->currentX + i;
        if (x >= OLED_WIDTH) continue;
        uint16_t y = oled->currentY;
        if (y >= OLED_HEIGHT) continue;

        uint8_t fontByte = charData[i];
        for (uint8_t bit = 0; bit < 7; bit++) {
            if (fontByte & (1 << bit)) {
                uint32_t pos = x + ((y + bit) / 8) * OLED_WIDTH;
                oled->buffer[pos] |= (1 << ((y + bit) % 8));
            }
        }
    }

    /* Сдвиг курсора (ваша существующая логика) */
    oled->currentX += 7 + 1;
    if (oled->currentX > OLED_WIDTH - 7) {
        oled->currentX = 0;
        oled->currentY += 8;
        if (oled->currentY >= OLED_HEIGHT) {
            oled->currentY = 0;
        }
    }
}



// Вывод строки
void OLED_WriteString_light(uint8_t update_src, OLED_HandleTypeDef *oled, uint16_t row, uint16_t col, char *str) {

    OLED_SetTextCursor(oled, row, col);
    int i = 0;
    while (str[i]) {
        OLED_WriteChar(oled, str[i++]);
    }
}

// Перевернуть экран по горизонтали
void OLED_FlipHorizontal(OLED_HandleTypeDef *oled, uint8_t flip) {
    if (flip) {
        OLED_WriteCommand(oled, 0xA0); // Seg re-map: column address 0 mapped to SEG0
    } else {
        OLED_WriteCommand(oled, 0xA1); // Seg re-map: column address 127 mapped to SEG0
    }
}

// Перевернуть экран по вертикали
void OLED_FlipVertical(OLED_HandleTypeDef *oled, uint8_t flip) {
    if (flip) {
        OLED_WriteCommand(oled, 0xC0); // COM output scan direction: normal mode
    } else {
        OLED_WriteCommand(oled, 0xC8); // COM output scan direction: remapped mode
    }
}

// Установка позиции текста (строка 0-3, столбец 0-25)
void OLED_SetTextCursor(OLED_HandleTypeDef *oled, uint16_t row, uint16_t col) {
    oled->currentX = col * (FONT_WIDTH + 1);
    oled->currentY = row * 8; // 8 пикселей на строку
}

// Инвертировать цвета дисплея
void OLED_InvertColors(OLED_HandleTypeDef *oled, uint8_t invert) {
    if (invert) {
        OLED_WriteCommand(oled, 0xA7); // Inverted display
    } else {
        OLED_WriteCommand(oled, 0xA6); // Normal display
    }
}
/**
 * @brief копирование в буфер с поворотом
 * 
 * @param oled структура содержащяя исходный буфер
 * @param lcd_mem копия буфера с поворотом 
 * @param mem_rotate поворот в памяти на 90, 180, 270
 */
void Copy_oled_mem(OLED_HandleTypeDef* oled, void* lcd_mem, int mem_rotate){
    //uint16_t* lcd_buffer565 = (uint16_t*)lcd_mem; //для цвета565 хорошо подходит uint16_t* указатель
    RGB888_Pixel* lcd_buffer888 = (RGB888_Pixel*)lcd_mem;
    uint8_t* mono_buffer = (uint8_t*)&oled->buffer;
    
    
    int offset_x = (REAL_HEIGHT - OLED_HEIGHT) / 2; //
    int offset_y = (REAL_WIDTH - OLED_WIDTH) / 2;  //
    
    // Копируем монохромное изображение в центр LCD
    for (int y = 0; y < OLED_HEIGHT; y++) {
        for (int x = 0; x < OLED_WIDTH; x++) {
            // Получаем значение пикселя из монохромного буфера
            int byte_index = x + (y / 8) * OLED_WIDTH;
            int bit_index = y % 8;
            int pixel_value = (mono_buffer[byte_index] >> bit_index) & 0x01;

            int rotated_x = 0;
            int rotated_y = 0;

            //TO DO разобраться с поворотом на 180
            if(mem_rotate == 0){
                rotated_x = OLED_HEIGHT - 1 - y; // 0-31
                rotated_y = x;                   // 0-127  
            }else if(mem_rotate == 1){
                rotated_x = y;                 //(бывшая высота становится шириной)
                rotated_y = OLED_WIDTH -1- x;    // (бывшая ширина становится высотой, перевернутой)
            }else if(mem_rotate == 2){
                rotated_x = OLED_WIDTH -1- x;  // 0-127  
                rotated_y = OLED_HEIGHT -1- y; // 0-31
            }else{
                rotated_x = x; // 0-31
                rotated_y = y;               // 0-127
            }
            
            int lcd_x = rotated_x + offset_x;
            int lcd_y = rotated_y + offset_y;
            
            //Копирование и установка цвета пикселя в RGB565
            if (lcd_x < OLED_HEIGHT && lcd_y < OLED_WIDTH) {
                //lcd_buffer565[lcd_y * OLED_HEIGHT + lcd_x] = pixel_value ? 0x0000 : 0xFFFF;
                size_t index = lcd_y * OLED_HEIGHT + lcd_x;
                if (pixel_value) {
                    lcd_buffer888[index].r = 0x00;
                    lcd_buffer888[index].g = 0x00;
                    lcd_buffer888[index].b = 0x00;
                } else {
                    lcd_buffer888[index].r = 0xFF;
                    lcd_buffer888[index].g = 0xFF;
                    lcd_buffer888[index].b = 0xFF;
                }
            }
        }
    }
}